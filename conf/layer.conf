## conf/layer.conf
```bitbake
# We have a conf and classes directory, add to BBPATH
BBPATH := "${BBPATH}:${LAYERDIR}"

# We have an images and various recipe-* directories, add to BBFILES
BBFILES := "${BBFILES} ${LAYERDIR}/recipes*/*/*.bb*"
	
BBFILE_COLLECTIONS += "cgx24-msd-cavium-thunderx"
BBFILE_PATTERN_cgx24-msd-cavium-thunderx := "^${LAYERDIR}/"
BBFILE_PRIORITY_cgx24-msd-cavium-thunderx = "7"

LAYERDEPENDS = "core"

PREFERRED_VERSION_linux-mvista_cavium-thunderx ?= "4.14%"
```

## conf/machine/include/cavium-thunderx.inc
```bitbake
# Cavium ThunderX defaults

require conf/machine/include/soc-family.inc
require conf/machine/include/tune-thunderx.inc

SOC_FAMILY = "cavium-thunderx"

# used by sysvinit_2

SERIAL_CONSOLE ?= "115200 ttyAMA0"
```
